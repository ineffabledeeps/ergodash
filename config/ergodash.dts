/ {
    leds {
        compatible = "worldsemi,ws2812-string";
        label = "WS2812";
        chain-length = <10>; // Set to the number of LEDs in your strip
        reg = <&pwm0 1 255>; // Use the correct PWM channel and settings for your setup
        pinctrl-0 = <&pwm0_default>;
        pinctrl-names = "default";
    };

    chosen {
        zmk,underglow = &leds;
    };
};
